## drivers/wireless/ieee802154/dw1000/Kconfig
```kconfig
#
# For a description of the syntax of this configuration file,
# see the file kconfig-language.txt in the NuttX tools repository.
#

if IEEE802154_DW1000

config DW1000_USE_PA
  bool "Is PA and LNA used"
  default n
  ---help---
		This enables support for external PA and LNA

endif # IEEE802154_DW1000
```

## wireless/uwb/Kconfig
```kconfig
#
# For a description of the syntax of this configuration file,
# see the file kconfig-language.txt in the NuttX tools repository.
#

menuconfig WIRELESS_UWB
	bool "IEEE 802.15.4 UWB Support"
	default n
	select MM_IOB
	depends on WIRELESS
	---help---
		Enables 802.15.4 UWB

if WIRELESS_UWB

endif # WIRELESS_UWB
```
